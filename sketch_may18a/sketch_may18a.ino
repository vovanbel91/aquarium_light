#include "Classes.h"                  //My OOP

#include <EncButton.h>                //Encoder
EncButton<EB_TICK, A0, A1, A2> enc;

#include "GyverPWM.h"                 // PWM

#include <Wire.h>                     //Clock
#include "RTClib.h"
RTC_DS3231 rtc;

#include <EEPROM.h>                   //EEPROM

#include "SSD1306Ascii.h"             //Display
#include "SSD1306AsciiAvrI2c.h"
SSD1306AsciiAvrI2c oled;


const unsigned char logo [] PROGMEM = {
  0x00, 0xfe, 0xfe, 0xfe, 0x0e, 0x42, 0x7a, 0x7a, 0x3a, 0x82, 0xfe, 0x7e, 0x1e, 0xde, 0xde, 0x1e, 
	0x1e, 0xfe, 0xfe, 0x9e, 0xde, 0xde, 0x1e, 0xfe, 0xfe, 0x1e, 0x9e, 0xde, 0xde, 0x1e, 0xfe, 0xfe, 
	0xfe, 0xfe, 0xfe, 0xfe, 0x00, 0xfe, 0xfe, 0xfe, 0x9e, 0x02, 0x7e, 0x7e, 0x7e, 0x06, 0xe2, 0xfe, 
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	0x7f, 0x7f, 0x7f, 0x7f, 0x7f, 0x7f, 0x7f, 0x79, 0x7c, 0x7c, 0x7c, 0x7e, 0x70, 0x7f, 0x7f, 0x00
};

byte r = 0; 
byte c = 0 ;
int a = 0;

bool EncRHFlag;
bool EncLHFlag;
bool EncRFlag;
bool EncLFlag;
bool EncClFlag;
bool EncHFlag;
bool Enc2CFlag;
bool ChEncFlag;
bool AwakeFlag;
bool IsInter;
bool SecFlag;

bool NeedClearFlag;
bool ClearSavedFlafg;
bool ChInTimeFlag;

bool OverflowNeededFlag;
float BrlMult;

bool ChTimeFlag;
bool ChFlag;

int CurH;
int CurM;
int CurS;
int MemS;

int EstBrl;
int8_t MenuCount;
int8_t MenuCountM;
int8_t BrlIndMode;
int NOWBRL[4];
int NOWWBRL[] {0,0,0,0};
int EnotherBrl[4];
int MemCount;

Value ChNavPos1;
Value ChMenu;
Value Brl[8];
Value CurStrip;
Value WorkTimeSet;
Timer TR1;
Timer TR2;
Timer TR3;
Timer TRMin;
TimeVal T1(10,0,0);
TimeVal T2(20,0,0);
TimeVal RT(0,0,0);

void setup() {

TRMin.Reset();
ReadTimeEEPROM();

ChNavPos1.ValueParam(0, 3);
ChMenu.ValueParam(0, 2);
CurStrip.ValueParam(0, 4);
WorkTimeSet.ValueParam(0, 2);

for (int i = 0; i < 3; i++ ){Brl[i].ValueParam(0, 256);};
for (int i = 4; i < 7; i++ ){Brl[i].ValueParam(0, 256);};
Brl[3].ValueParam(0, 2);
Brl[7].ValueParam(0, 2);

oled.begin(&Adafruit128x32, 0x3C);
oled.setFont(Adafruit5x7);

Serial.begin (9600);
//Serial.println ("end setup");

pinMode(LED_BUILTIN, OUTPUT);

OverflowNeededFlag = 1;

pinMode(3, OUTPUT);
pinMode(5, OUTPUT);
pinMode(9, OUTPUT);
pinMode(10, OUTPUT);

PWM_frequency(3, 40000, CORRECT_PWM);
PWM_frequency(9, 40000, CORRECT_PWM);
PWM_frequency(10,40000, CORRECT_PWM);

ReadBrlEEPROM ();

AwakeFlag = 1;


  for (byte b = 0; b < 4; b++) { // I'm expecting to occupy all the 4 rows of the display
    oled.setCursor (c,(r+b)); 
    for (byte i = 0; i < 128; i++) { // since I need to occupy all the 4 rows of the display, I divided the number of elements of the logo array (512) by 4. This is why I got 128.
      oled.ssd1306WriteRam(pgm_read_byte(&logo[a]));
      a++;
    }  
  }


delay(2500);

oled.clear();
}

void loop() {
  
  enc.tick();

  DateTime now = rtc.now();
  TR1.Get(now.second());
  TR2.Get(now.second());
  TR3.Get(now.second());
  TRMin.Get(now.second());

  CurH = now.hour();
  CurM = now.minute();
  CurS = now.second();//now.second();

  if (enc.leftH()) {EncRHFlag = 1; ChFlag = 1; IsInter = 1; TR2.Reset();};
  if (enc.rightH()) {EncLHFlag = 1; ChFlag = 1; IsInter = 1; TR2.Reset();};
  if (enc.left()) {EncRFlag = 1; ChFlag = 1; IsInter = 1; TR2.Reset();};
  if (enc.right()) {EncLFlag = 1; ChFlag = 1; IsInter = 1; TR2.Reset();};
  if (enc.click()) {EncClFlag = 1; IsInter = 1; TR2.Reset(); if (ChMenu.Count() == 1) ChFlag = 1;};
  if (enc.held()) {EncHFlag = 1; IsInter = 1; TR2.Reset();};
  if (enc.hasClicks(2)) {Enc2CFlag = 1; IsInter = 1; TR2.Reset();};

  MENUMGMT();
  
  if (MemS != CurS){MemS = CurS; SecFlag = 1;
   BrlMGMT();          //refreshes PWM every second
   OverflowIsNeeded(); //check the time for overflow
  };




}